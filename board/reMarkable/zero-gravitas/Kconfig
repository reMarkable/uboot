## board/reMarkable/zero-gravitas/Kconfig
```kconfig
if TARGET_ZERO_GRAVITAS

config SYS_BOARD
	default "zero-gravitas"

config SYS_VENDOR
	default "reMarkable"

config SYS_CONFIG_NAME
	default "zero-gravitas"

endif
```

## board/reMarkable/zero-sugar/Kconfig
```kconfig
if TARGET_ZERO_SUGAR

config SYS_BOARD
	default "zero-sugar"

config SYS_VENDOR
	default "reMarkable"

config SYS_CONFIG_NAME
	default "zero-sugar"

config SYS_TEXT_BASE
	default 0x87800000
endif
```

## configs/zero-gravitas_defconfig
```kconfig
CONFIG_ARM=y
CONFIG_ARCH_MX6=y
CONFIG_TARGET_ZERO_GRAVITAS=y
CONFIG_LOCALVERSION="-zero-gravitas"
CONFIG_SYS_EXTRA_OPTIONS="IMX_CONFIG=board/reMarkable/zero-gravitas/imximage.cfg,MX6SL"
CONFIG_HUSH_PARSER=y
CONFIG_SYS_PROMPT="rM> "
CONFIG_CMD_BOOTZ=y
# CONFIG_CMD_IMLS is not set
CONFIG_CMD_MEMTEST=y
CONFIG_CMD_MEMINFO=y
CONFIG_CMD_MMC=y
# CONFIG_CMD_FPGA is not set
# CONFIG_CMD_SETEXPR is not set
CONFIG_CMD_EXT4=y
CONFIG_CMD_FAT=y
CONFIG_DM=y
CONFIG_DM_THERMAL=y
CONFIG_OF_LIBFDT=y
# CONFIG_EFI_LOADER is not set

# disable currently unused features to reduce size of u-boot
CONFIG_CMD_BOOTD=n
CONFIG_CMD_ELF=n
CONFIG_CMD_XIMG=n
CONFIG_CMD_IMI=n
CONFIG_CMD_BDI=n
CONFIG_CMD_LOADB=n
CONFIG_CMD_LOADS=n
CONFIG_CMD_FLASH=n
CONFIG_CMD_USB=n
CONFIG_CMD_NET=n
CONFIG_CMD_DHCP=n
CONFIG_CMD_NFS=n
CONFIG_CMD_MISC=n
CONFIG_NET=n

# CONFIG_CMDFDT=n
CONFIG_CMD_GO=n
CONFIG_CMD_EXPORTENV=n
CONFIG_CMD_IMPORTENV=n
CONFIG_CMD_EDITENV=n
CONFIG_CMD_CRC32=n
CONFIG_CMD_ITEST=n
CONFIG_CMD_SOURCE=n
CONFIG_CMD_DM=n
CONFIG_CMD_GPIO=n
```
